## drivers/sprav/Kconfig
```kconfig
# SPRAV configuration options

# Copyright (c) 2023 Maximilian Barger
# SPDX-License-Identifier: Apache-2.0

config SPRAV
	bool "SPRAV (Simple Post-Quantum Remote Attestation for RISC-V Devices)"
	default n
	help
	  "Enables SPRAV"

if SPRAV
	config MAIN_STACK_SIZE
		default 131072
	config ENTROPY_GENERATOR
		default y
endif

config SPRAV_PRAC_ONLY
	bool "Operate without a vrac: Only output information (for debugging only)"
	depends on SPRAV
	help
	  "Operate without a vrac: Only output information (for debugging only)"
```

## samples/pmp/sample.yaml
```yaml
sample:
  description: A simple application that demonstrates PMP
  name: RISC-V PMP
tests:
  sample.kernel.synchronization:
    build_on_all: true
    tags: pmp
    harness: console
    harness_config:
      type: multi_line
```
